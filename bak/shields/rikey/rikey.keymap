#include <behavior.dtsi>
#include <dt-bindings/zmk/keys.h>

/ {
    keymap {
        compatible = "zmk,keymap";

        default_layer {
            bindings = <
                &kp A   &kp B   &kp C   &kp D    &kp A   &kp B   &kp C
            >;
        }
    }
}
